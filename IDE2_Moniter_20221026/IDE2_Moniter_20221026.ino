/* broadcast_Train Moniter
 * 2021/09/21  Ver1.00 初版
 * 2022/10/26  Ver3.00 モニター強化（パラメーター追加）  
 *             JROBO junichi itoh
 */

#include <esp_now.h>
#include <WiFi.h>

esp_now_peer_info_t slave;

// ** 受信コールバック *********************************************************************
void OnDataRecv(const uint8_t *mac_addr, const uint8_t *data, int data_len) {
  char macStr[18];
  snprintf(macStr, sizeof(macStr), "%02X:%02X:%02X:%02X:%02X:%02X",
           mac_addr[0], mac_addr[1], mac_addr[2], mac_addr[3], mac_addr[4], mac_addr[5]);
  for ( int i = 0 ; i < data_len ; i++ ) {
    Serial.print(data[i]);
    Serial.print(",");
  }
  Serial.print("\n");
}
// ***************************************************************************************

// ** setup ******************************************************************************
void setup() {
  Serial.begin(115200);
  // ** ESP-NOW初期化 *********************************************************************
  WiFi.mode(WIFI_STA);
  WiFi.disconnect();
  if (esp_now_init() == ESP_OK) {
  } else {
    return;
  }
// ***************************************************************************************
  // ** マルチキャスト用Slave登録 ************************************************************
  memset(&slave, 0, sizeof(slave));
  for (int i = 0; i < 6; ++i) {
    slave.peer_addr[i] = (uint8_t)0xff;
  }
  esp_err_t addStatus = esp_now_add_peer(&slave);
  if (addStatus == ESP_OK) {
  }
// ****************************************************************************************
  // ** ESP-NOWコールバック登録 **************************************************************
  esp_now_register_recv_cb(OnDataRecv);
// ****************************************************************************************
  disableCore0WDT();                      // watchdog timer対応
  disableCore1WDT();                      // watchdog timer対応
}
// ****************************************************************************************

// ** Loop ********************************************************************************
void loop() {
  // ** F0/0:10  F0/1:20  F1/0:30 F1/1:40 B0/0:50  B0/1:60 B1/0:70 B1/1:80 **************** 
  // **************************************************************************************
  delay(1);                               // watchdog timer対応
}
// ****************************************************************************************
